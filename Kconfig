## Kconfig
```kconfig
menu "PC Fan"
    choice PC_FAN_LEDC_SPEED_MODE
        prompt "LEDC Speed Mode"
        default PC_FAN_LEDC_HIGH_SPEED_MODE if IDF_TARGET_ESP32
        default PC_FAN_LEDC_LOW_SPEED_MODE if !IDF_TARGET_ESP32

        config PC_FAN_LEDC_HIGH_SPEED_MODE
            bool "LEDC high speed mode"
        config PC_FAN_LEDC_LOW_SPEED_MODE
            bool "LEDC low speed mode"
    endchoice
endmenu
```

## example/main/Kconfig.projbuild
```kconfig
menu "Hardware config"
    config HW_PWM_PIN
        int "Fan speed control PIN (PWM)"
        default 25

    config HW_RPM_PIN
        int "Fan RPM reporting PIN"
        default 26

    config HW_RPM_SAMPLES
        int "Fan RPM samples count"
        default 5
        help
            How many samples are used to smooth the RPM value.
endmenu
```
